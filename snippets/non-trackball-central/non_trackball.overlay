#include "../non_trackball.overlay"

// split経由のリスナーを有効化
&peripheral_listener {
    status = "okay";

    input-processors = <
        &zip_xy_transform (INPUT_TRANSFORM_XY_SWAP | INPUT_TRANSFORM_X_INVERT)
        &zip_temp_layer 5 10000
    >;

    scroller {
        layers = <6>;
        process-next;
        input-processors = <
            &zip_xy_to_scroll_mapper
            &zip_scroll_transform (INPUT_TRANSFORM_XY_SWAP | INPUT_TRANSFORM_X_INVERT)
            &zip_scroll_scaler 1 16
        >;
    };
};

&zip_temp_layer {
    require-prior-idle-ms = <200>;
}
