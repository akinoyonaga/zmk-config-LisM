#include "lism.dtsi"
#include <input/processors.dtsi>

&aml_threshold {
    excluded-positions = <
        16 // J
        18 // K
    >;
};

&transform_42keymap {
    col-offset = <5>;
};

&transform_40keymap {
    col-offset = <5>;
};
