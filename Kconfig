## Kconfig
```kconfig
config LISM_INPUT_PROCESSOR_TEMP_LAYER_THRESHOLD
    bool "LisM threshold-based temporary layer input processor"
    default y
    depends on ZMK_POINTING
    depends on (!ZMK_SPLIT || ZMK_SPLIT_ROLE_CENTRAL)

if LISM_INPUT_PROCESSOR_TEMP_LAYER_THRESHOLD

config LISM_INPUT_PROCESSOR_TEMP_LAYER_THRESHOLD_MAX_ACTION_EVENTS
    int "Maximum number of queued layer actions"
    default 16

endif
```
